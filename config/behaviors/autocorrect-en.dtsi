// Common English autocorrect word list
// Based on zmk-autocorrect-module standard corrections

/ {
    autocorrect {
        // Common typos -> corrections
        corrections = <
            // THE family
            "teh" "the"
            "hte" "the"
            "tthe" "the"
            
            // AND family  
            "adn" "and"
            "nad" "and"
            "andd" "and"
            
            // WITH family
            "wiht" "with"
            "wtih" "with"
            "whit" "with"
            
            // THAT family
            "taht" "that"
            "tath" "that"
            "thta" "that"
            
            // HAVE family
            "ahve" "have"
            "hav" "have"
            "havee" "have"
            
            // THIS family
            "htis" "this"
            "thsi" "this"
            "tihs" "this"
            
            // FROM family
            "form" "from"
            "fomr" "from"
            "frmo" "from"
            
            // THEY family
            "htey" "they"
            "tehy" "they"
            "tyhe" "they"
            
            // WERE family
            "wer" "were"
            "weer" "were"
            "wree" "were"
            
            // BEEN family
            "ben" "been"
            "bene" "been"
            "beeen" "been"
            
            // HAVE/HAS contractions
            "dont" "don't"
            "doesnt" "doesn't"
            "didnt" "didn't"
            "wont" "won't"
            "cant" "can't"
            "isnt" "isn't"
            "arent" "aren't"
            "wasnt" "wasn't"
            "werent" "weren't"
            "hasnt" "hasn't"
            "havent" "haven't"
            "hadnt" "hadn't"
            "shouldnt" "shouldn't"
            "wouldnt" "wouldn't"
            "couldnt" "couldn't"
            
            // Common words
            "youre" "you're"
            "recieve" "receive"
            "beleive" "believe"
            "acheive" "achieve"
            "occured" "occurred"
            "seperate" "separate"
            "definately" "definitely"
            "truely" "truly"
            "untill" "until"
            "becuase" "because"
            "beacuse" "because"
            "buisness" "business"
            "freind" "friend"
            "agian" "again"
            "reccommend" "recommend"
            "necesary" "necessary"
            "accomodate" "accommodate"
        >;
    };
};
