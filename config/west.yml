## config/west.yml
```yaml
manifest:
  remotes:
    - name: zmkfirmware
      url-base: https://github.com/zmkfirmware
    - name: valkride
      url-base: https://github.com/valkride
  projects:
    - name: zmk
      remote: zmkfirmware
      revision: main
      import: app/west.yml
    - name: zmk-pmw3610-driver
      remote: valkride
      revision: main
    - name: zmk-nice-oled
      remote: valkride
      revision: main
    - name: zmk-auto-layer
      remote: valkride
      revision: main
    - name: zmk-autocorrect-module
      remote: valkride
      revision: main
  self:
    path: config
```
