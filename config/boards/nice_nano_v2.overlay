/*
 * Memory optimization overlay for Nice Nano v2 with large dictionary support
 * Configures heap and stack for large dictionary processing
 */

/ {
    /* Configure larger heap for dictionary operations */
    chosen {
        zephyr,sram = &sram0;
    };
};